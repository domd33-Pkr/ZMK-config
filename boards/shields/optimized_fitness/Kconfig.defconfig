## boards/shields/optimized_fitness/Kconfig.defconfig
```kconfig
if SHIELD_OPTIMIZED_FITNESS_LEFT || SHIELD_OPTIMIZED_FITNESS_RIGHT

config ZMK_KEYBOARD_NAME
    default "Optimized Fit"

config ZMK_SPLIT
    default y

endif
```

## boards/shields/optimized_fitness/Kconfig.shield
```kconfig
config SHIELD_OPTIMIZED_FITNESS_LEFT
    def_bool $(shields_list_contains,optimized_fitness_left)

config SHIELD_OPTIMIZED_FITNESS_RIGHT
    def_bool $(shields_list_contains,optimized_fitness_right)
```
