#include "optimized_fitness.dtsi"

/ {
    chosen {
        zmk,kscan = &kscan0;
    };

    kscan0: kscan {
        compatible = "zmk,kscan-gpio-direct";
        label = "KSCAN";
        input-gpios
            = <&pro_micro 1 (GPIO_ACTIVE_LOW | GPIO_PULL_UP)> // Index 1
            , <&pro_micro 0 (GPIO_ACTIVE_LOW | GPIO_PULL_UP)> // Index 2
            , <&pro_micro 2 (GPIO_ACTIVE_LOW | GPIO_PULL_UP)> // Index 3
            , <&pro_micro 3 (GPIO_ACTIVE_LOW | GPIO_PULL_UP)> // Index 4
            , <&pro_micro 4 (GPIO_ACTIVE_LOW | GPIO_PULL_UP)> // Index 5
            , <&pro_micro 5 (GPIO_ACTIVE_LOW | GPIO_PULL_UP)> // Index 6
            , <&pro_micro 6 (GPIO_ACTIVE_LOW | GPIO_PULL_UP)> // Index 7
            , <&pro_micro 7 (GPIO_ACTIVE_LOW | GPIO_PULL_UP)> // Index 8
            , <&pro_micro 8 (GPIO_ACTIVE_LOW | GPIO_PULL_UP)> // Index 9
            , <&pro_micro 9 (GPIO_ACTIVE_LOW | GPIO_PULL_UP)> // Index 10
            ;
    };
};

&uart0 {
    status = "disabled";
};
